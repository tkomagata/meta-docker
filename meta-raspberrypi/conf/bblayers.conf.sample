## meta-raspberrypi/conf/layer.conf
```bitbake
# We have a conf and classes directory, add to BBPATH
BBPATH .= ":${LAYERDIR}"

# We have recipes-* directories, add to BBFILES
BBFILES += "${LAYERDIR}/recipes-*/*/*.bb \
            ${LAYERDIR}/recipes-*/*/*.bbappend"

BBFILE_COLLECTIONS += "meta-docker-raspberrypi"
BBFILE_PATTERN_meta-docker-raspberrypi = "^${LAYERDIR}/"
BBFILE_PRIORITY_meta-docker-raspberrypi = "6"

LAYERDEPENDS_meta-docker-raspberrypi = "raspberrypi virtualization-layer"
LAYERSERIES_COMPAT_meta-docker-raspberrypi = "dunfell"
```

## meta-rcar-gen3/conf/layer.conf
```bitbake
# We have a conf and classes directory, add to BBPATH
BBPATH .= ":${LAYERDIR}"

# We have recipes-* directories, add to BBFILES
BBFILES += "${LAYERDIR}/recipes-*/*/*.bb \
            ${LAYERDIR}/recipes-*/*/*.bbappend"

BBFILE_COLLECTIONS += "meta-docker-rcar-gen3"
BBFILE_PATTERN_meta-docker-rcar-gen3 = "^${LAYERDIR}/"
BBFILE_PRIORITY_meta-docker-rcar-gen3 = "6"

LAYERDEPENDS_meta-docker-rcar-gen3 = "rcar-gen3 virtualization-layer"
LAYERSERIES_COMPAT_meta-docker-rcar-gen3 = "dunfell"
```
